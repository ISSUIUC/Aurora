#define LOG_LOCAL_LEVEL ESP_LOG_VERBOSE

#include "max_read2.h"

#include <stdio.h>
#include "driver/i2s_common.h"
#include "driver/i2s_std.h"
#include "pins.h"
#include "portmacro.h"

// #include "freertos/FreeRTOS.h"
// #include "freertos/task.h"


char buf[128];
size_t bytes_read;
// Reference:
// https://github.com/espressif/esp-idf/tree/v5.5.1/examples/peripherals/i2s/i2s_recorder

void printbin(char *data,int len){
    for(int i =0;i<len;i++){
        printf("%02x ",(unsigned char)data[i]);
    }
}
void read_max2(void) {
    i2s_chan_handle_t rx_handle = NULL;
    i2s_chan_config_t chan_cfg = I2S_CHANNEL_DEFAULT_CONFIG(I2S_NUM_AUTO, I2S_ROLE_SLAVE);
    int ret3 = i2s_new_channel(&chan_cfg, NULL, &rx_handle);
    while (ret3 != ESP_OK) printf("Nope no new channel %x", ret3);
    while (rx_handle == NULL) printf("RX Handle is null");
    // struct i2s_chan_config_t config = {
    //     id=0,
    //     role=I2S_ROLE_SLAVE,
    //     dma_desc_num= something to fill in,
    //     dma_frame_num=24, // not sure if it's right,
    //     auto_clear = false 
    // };
    
/* Setting the configurations, the slot configuration and clock configuration can be generated by the macros
 * These two helper macros are defined in `i2s_std.h` which can only be used in STD mode.
 * They can help to specify the slot and clock configurations for initialization or updating */
    i2s_std_config_t std_cfg = {
        .slot_cfg = I2S_STD_MSB_SLOT_DEFAULT_CONFIG(I2S_DATA_BIT_WIDTH_32BIT, I2S_SLOT_MODE_MONO),
        // .clk_cfg = {
        //     .sample_rate_hz = 8e6,
        //     .clk_src = I2S_CLK_SRC_EXTERNAL,
        //     .mclk_multiple = 256,
        //     .bclk_div = 8
        // },
        .clk_cfg=I2S_STD_CLK_DEFAULT_CONFIG(48000),
        .gpio_cfg = {
            .mclk = I2S_GPIO_UNUSED,
            .dout = I2S_GPIO_UNUSED,
            .bclk = I0,
            .din = I1,
            .ws = Q1,
            .invert_flags = {
                .mclk_inv = false,
                .bclk_inv = false,
                .ws_inv = false,
            },
        },
    };
    /* Initialize the channel */
    int ret2 = i2s_channel_init_std_mode(rx_handle, &std_cfg);
    while(ret2 != ESP_OK) printf("Error init %x\n",ret2);

    /* Before reading data, start the RX channel first */
    i2s_channel_enable(rx_handle);
    // while(ret2 != ESP_OK) printf("Error enabling %x\n",ret2);

    while(true){
        int ret = i2s_channel_read(rx_handle, buf, 128, &bytes_read, portMAX_DELAY);
        if(ret != ESP_OK){
            printf("Error reading %d\n",ret);
        } else {
            printf("Read %d bytes\n",(int)bytes_read);
            printbin(buf,bytes_read);
        }
    }
    /* Have to stop the channel before deleting it */
    i2s_channel_disable(rx_handle);
    /* If the handle is not needed any more, delete it to release the channel resources */
    i2s_del_channel(rx_handle);
}
